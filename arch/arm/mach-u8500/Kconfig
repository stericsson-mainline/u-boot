## arch/arm/mach-u8500/Kconfig
```kconfig
if ARCH_U8500

config SYS_SOC
	default "u8500"

choice
	prompt "U8500 board selection"

config TARGET_STEMMY
	bool "Samsung (stemmy) board"

endchoice

source "board/ste/stemmy/Kconfig"

endif
```

## board/ste/stemmy/Kconfig
```kconfig
if TARGET_STEMMY

config SYS_BOARD
	default "stemmy"

config SYS_VENDOR
	default "ste"

config SYS_CONFIG_NAME
	default "stemmy"

config SYS_TEXT_BASE
	default 0x100000

config NR_DRAM_BANKS
	default 1

config DEFAULT_DEVICE_TREE
	default "ste-samsung-stemmy"

endif
```
